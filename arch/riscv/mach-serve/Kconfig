## arch/riscv/mach-serve/Kconfig
```kconfig
if TARGET_ICT_SERVE

config SERVE_CLK_SLCR
	bool "clock framework based on slcr on SERVE.r"
	default n

config ZYNQ_SDHCI_MAX_FREQ
	default 52000000

config SERVE_ZYNQMP
        bool "SERVE prototyping w/ Zynq MPSoC"
	default n

endif
```

## board/ict/serve/Kconfig
```kconfig
if TARGET_ICT_SERVE

config SYS_BOARD
	default "serve"

config SYS_VENDOR
	default "ict"

config SYS_CPU
	default "generic"

config SYS_CONFIG_NAME
	string "Board configuration name"
	default "ict-serve-r"

config ZYNQ_SDHCI_MAX_FREQ
	default 52000000

config BOARD_SPECIFIC_OPTIONS # dummy
	def_bool y
	select GENERIC_RISCV
	select CMD_DHCP
	select CMD_EXT2
	select CMD_EXT4
	select CMD_FAT
	select CMD_FS_GENERIC
	select CMD_NET
	select CMD_PING
	select DOS_PARTITION
	select EFI_PARTITION
	select IP_DYN
	select ISO_PARTITION
	select XILINX_UARTLITE
	select XILINX_AXIEMAC 
	select MII
	select NET_RANDOM_ETHADDR
	select PHYLIB
	select PHY_FIXED
	select PHY_TI
	select SMP

endif
```

## configs/ict_serve_h_defconfig
```kconfig
CONFIG_RISCV=y
CONFIG_RISCV_SMODE=y
CONFIG_TARGET_ICT_SERVE=y
CONFIG_SYS_TEXT_BASE=0x50200000
CONFIG_SYS_CONFIG_NAME="ict-serve-h"
CONFIG_NR_DRAM_BANKS=1
CONFIG_ARCH_RV64I=y
CONFIG_DISTRO_DEFAULTS=y
CONFIG_FIT=y
CONFIG_DISPLAY_CPUINFO=y
CONFIG_DISPLAY_BOARDINFO=y
CONFIG_CMD_BCB=y
CONFIG_CMD_CLK=y
CONFIG_OF_EMBED=y
CONFIG_CACHE=y
CONFIG_MISC=y
CONFIG_EMEMORY_OTP=y
CONFIG_RAM=y
```

## configs/ict_serve_i_defconfig
```kconfig
CONFIG_RISCV=y
CONFIG_RISCV_SMODE=y
CONFIG_TARGET_ICT_SERVE=y
CONFIG_SERVE_ZYNQMP=y
CONFIG_SYS_TEXT_BASE=0xB0200000
CONFIG_SYS_CONFIG_NAME="ict-serve-i"
CONFIG_NR_DRAM_BANKS=1
CONFIG_ARCH_RV64I=y
CONFIG_DISTRO_DEFAULTS=y
CONFIG_FIT=y
CONFIG_DISPLAY_CPUINFO=y
CONFIG_DISPLAY_BOARDINFO=y
CONFIG_CMD_BCB=y
CONFIG_CMD_CLK=y
CONFIG_OF_EMBED=y
CONFIG_CACHE=y
CONFIG_MISC=y
CONFIG_EMEMORY_OTP=y
CONFIG_RAM=y
CONFIG_DEBUG_UART=y
CONFIG_DEBUG_UART_BASE=0xFF000000
CONFIG_DEBUG_UART_CLOCK=50000000
CONFIG_DEBUG_UART_ZYNQ=y
CONFIG_ZYNQ_SERIAL=y
CONFIG_MMC=y
CONFIG_CMD_MMC=y
CONFIG_MMC_BROKEN_CD=y
CONFIG_MMC_SDHCI=y
CONFIG_MMC_SDHCI_ZYNQ=y
CONFIG_ZYNQ_GEM=y
CONFIG_CLK_ZYNQMP=y
CONFIG_BOOTCOMMAND="load mmc 0 0x10000000 env.txt;env import 0x10000000 $filesize;setenv -f eth1addr $mac1;setenv ipaddr $my_ip;setenv serverip $server_ip;tftp 0xB0600000 Image;tftp 0xB2500000 serve_i_freedom.dtb;booti 0xB0600000 - 0xB2500000"
```

## configs/ict_serve_v_defconfig
```kconfig
CONFIG_RISCV=y
CONFIG_RISCV_SMODE=y
CONFIG_TARGET_ICT_SERVE=y
CONFIG_SERVE_ZYNQMP=y
CONFIG_SYS_TEXT_BASE=0x80200000
CONFIG_SYS_CONFIG_NAME="ict-serve-v"
CONFIG_NR_DRAM_BANKS=1
CONFIG_ARCH_RV64I=y
CONFIG_DISTRO_DEFAULTS=y
CONFIG_FIT=y
CONFIG_DISPLAY_CPUINFO=y
CONFIG_DISPLAY_BOARDINFO=y
CONFIG_CMD_BCB=y
CONFIG_CMD_CLK=y
CONFIG_OF_EMBED=y
CONFIG_CACHE=y
CONFIG_MISC=y
CONFIG_EMEMORY_OTP=y
CONFIG_RAM=y
CONFIG_PCI=y
CONFIG_NVME=y
CONFIG_DM_PCI=y
CONFIG_PCI_XDMA_PL=y
CONFIG_CMD_PCI=y
CONFIG_CMD_NVME=y
CONFIG_CMD_EXT4_WRITE=y
CONFIG_DEBUG_UART=y
CONFIG_DEBUG_UART_BASE=0x7F000000
CONFIG_DEBUG_UART_CLOCK=50000000
CONFIG_DEBUG_UART_ZYNQ=y
CONFIG_ZYNQ_SERIAL=y
CONFIG_CLK_ZYNQMP=y
```
